/dts-v1/;
/plugin/;

/ {
	compatible = "ti,beaglebone", "ti,beaglebone-black", "ti,beaglebone-green";

	part-number = "PRU0-example";

	version = "00A0";

	exclusive-use =
		"P8.11", "P8.16", "pru0";

	fragment@0 {
		target = <&am33xx_pinmux>;
		__overlay__ {
			pru0_example_pins: pinmux_pru_pru_pins {
				pinctrl-single,pins = <
					0x34 0x06
					0x38 0x26
				>;
			};
		};
	};

	fragment@1 {
		target = <&pruss>;
		__overlay__ {
			status = "okay";
			pinctrl-names = "default";
			pinctrl-0 = <&pru0_example_pins>;
		};
	};
};
